&trackball_central_listener {
    status = "okay";
    device = <&trackball_central>;
    input-processors 
      = <&zip_scroll_transform (INPUT_TRANSFORM_X_INVERT | INPUT_TRANSFORM_Y_INVERT)>
      , <&zip_xy_to_scroll_mapper>
      , <&zip_ble_report_rate_limit>;
};