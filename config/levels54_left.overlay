&trackball_peripheral_split {
    device = <&trackball_peripheral>;
    input-processors
      = <&zip_xy_transform (INPUT_TRANSFORM_X_INVERT | INPUT_TRANSFORM_Y_INVERT)>
      , <&zip_ble_report_rate_limit>;  
};